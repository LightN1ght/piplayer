## configs/player_defconfig
```kconfig
BR2_aarch64=y
BR2_cortex_a72=y
BR2_TOOLCHAIN_EXTERNAL=y
BR2_TOOLCHAIN_EXTERNAL_BOOTLIN=y
BR2_TOOLCHAIN_EXTERNAL_BOOTLIN_AARCH64_MUSL_STABLE=y
BR2_GLOBAL_PATCH_DIR="board/raspberrypi/patches"
BR2_DOWNLOAD_FORCE_CHECK_HASHES=y
BR2_TARGET_GENERIC_HOSTNAME="piplayer"
BR2_TARGET_GENERIC_ISSUE="PiPlayer - SFTP /data/media, HTTP :8080"
# BR2_TARGET_ENABLE_ROOT_LOGIN is not set
BR2_SYSTEM_DHCP="eth0 eth1"
BR2_TARGET_GENERIC_GETTY_PORT="ttyAMA0"
BR2_ROOTFS_OVERLAY="$(BR2_EXTERNAL_PIPLAYER_PATH)/board/player/rootfs-overlay"
BR2_ROOTFS_USERS_TABLES="$(BR2_EXTERNAL_PIPLAYER_PATH)/.local/users.txt"
BR2_ROOTFS_POST_BUILD_SCRIPT="$(BR2_EXTERNAL_PIPLAYER_PATH)/board/player/post-build.sh"
BR2_ROOTFS_POST_IMAGE_SCRIPT="$(BR2_EXTERNAL_PIPLAYER_PATH)/board/player/post-image.sh"
BR2_LINUX_KERNEL=y
BR2_LINUX_KERNEL_CUSTOM_TARBALL=y
BR2_LINUX_KERNEL_CUSTOM_TARBALL_LOCATION="$(call github,raspberrypi,linux,576cc10e1ed50a9eacffc7a05c796051d7343ea4)/linux-576cc10e1ed50a9eacffc7a05c796051d7343ea4.tar.gz"
BR2_LINUX_KERNEL_DEFCONFIG="bcm2711"
BR2_LINUX_KERNEL_CONFIG_FRAGMENT_FILES="$(BR2_EXTERNAL_PIPLAYER_PATH)/board/player/linux.fragment"
BR2_LINUX_KERNEL_DTS_SUPPORT=y
BR2_LINUX_KERNEL_INTREE_DTS_NAME="broadcom/bcm2711-rpi-4-b"
BR2_LINUX_KERNEL_NEEDS_HOST_OPENSSL=y
BR2_PACKAGE_BUSYBOX_SHOW_OTHERS=y
BR2_PACKAGE_BUSYBOX_CONFIG_FRAGMENT_FILES="$(BR2_EXTERNAL_PIPLAYER_PATH)/board/player/busybox.fragment"
BR2_PACKAGE_RPI_FIRMWARE=y
BR2_PACKAGE_RPI_FIRMWARE_VARIANT_PI4=y
BR2_PACKAGE_RPI_FIRMWARE_CONFIG_FILE="$(BR2_EXTERNAL_PIPLAYER_PATH)/board/player/config.txt"
BR2_PACKAGE_BRCMFMAC_SDIO_FIRMWARE_RPI=y
BR2_PACKAGE_BRCMFMAC_SDIO_FIRMWARE_RPI_WIFI=y
BR2_PACKAGE_WIRELESS_REGDB=y
BR2_PACKAGE_IW=y
BR2_PACKAGE_HOSTAPD=y
BR2_PACKAGE_HOSTAPD_DRIVER_NL80211=y
# BR2_PACKAGE_HOSTAPD_EAP is not set
# BR2_PACKAGE_HOSTAPD_WPS is not set
BR2_PACKAGE_DNSMASQ=y
BR2_PACKAGE_DNSMASQ_DHCP=y
BR2_PACKAGE_OPENSSH=y
# BR2_PACKAGE_OPENSSH_CLIENT is not set
BR2_PACKAGE_NGINX=y
# BR2_PACKAGE_NGINX_HTTP_REWRITE_MODULE is not set
# BR2_PACKAGE_NGINX_HTTP_GZIP_MODULE is not set
BR2_PACKAGE_FFMPEG=y
BR2_PACKAGE_FFMPEG_FFPROBE=y
BR2_PACKAGE_FFMPEG_ENCODERS=""
BR2_PACKAGE_FFMPEG_DECODERS="h264 aac"
BR2_PACKAGE_FFMPEG_MUXERS="hls mpegts mov"
BR2_PACKAGE_FFMPEG_DEMUXERS="mov mpegts"
BR2_PACKAGE_FFMPEG_PARSERS="h264 aac"
BR2_PACKAGE_FFMPEG_BSFS="h264_mp4toannexb aac_adtstoasc"
BR2_PACKAGE_FFMPEG_PROTOCOLS="file pipe crypto"
BR2_PACKAGE_FFMPEG_FILTERS=""
BR2_PACKAGE_FFMPEG_EXTRACONF="--disable-debug --enable-small --disable-autodetect"
BR2_TARGET_ROOTFS_EXT2=y
BR2_TARGET_ROOTFS_EXT2_4=y
BR2_TARGET_ROOTFS_EXT2_LABEL="piplayer"
BR2_TARGET_ROOTFS_EXT2_SIZE="384M"
# BR2_TARGET_ROOTFS_TAR is not set
BR2_PACKAGE_HOST_DOSFSTOOLS=y
BR2_PACKAGE_HOST_GENIMAGE=y
BR2_PACKAGE_HOST_MTOOLS=y
```
